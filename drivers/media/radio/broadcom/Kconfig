## drivers/media/radio/broadcom/Kconfig
```kconfig
#
# Broadcom FM driver based on v4l2.
#
menu "Broadcom FM driver (v4l2 based)"
config RADIO_BROADCOM
	tristate "Broadcom FM Radio"
	depends on VIDEO_V4L2
	help
	Choose Y here if you have this FM radio chip.

	In order to control your radio card, you will need to use programs
	that are compatible with the Video For Linux 2 API.  Information on
	this API and pointers to "v4l2" programs may be found at
	<file:Documentation/video4linux/API.html>.

endmenu
```
